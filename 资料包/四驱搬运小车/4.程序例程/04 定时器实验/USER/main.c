/***************************************************************************
本程序可供学习使用，经作者允许，也可用于其他用途。如有意见及建议，欢迎来电交流指教
硬件版本：四路麦轮多功能控制板
主控芯片：STM32F103RCT6
程序名称：定时器程序
功能描述：定时器控制LED灯闪烁


*****************************************************************************/



#include "sys.h"
#include "led.h"
#include "timer.h"

unsigned char timer_stick=0;

int main(void)
{		
  Stm32_Clock_Init(9);			//系统时钟设置
	LED_Init();         			//LED初始化	 
	TIM6_Int_Init(4999,71);	  //5ms中断溢出
	TIM3_Int_Init(499,71);	
	while(1)
	{

	} 
}

//定时器6中断服务程序	 
void TIM6_IRQHandler(void)
{ 		    		  			    
	if(TIM6->SR&0X0001)//溢出中断
	{			
		timer_stick++;
		if(timer_stick==100)	//250ms
		{
			LED0=~LED0;
		}
	}
	TIM6->SR&=~(1<<0);//清除中断标志位 	    
}
//定时器3中断服务程序	 
void TIM3_IRQHandler(void)
{ 		    		  			    
	if(TIM3->SR&0X0001)//溢出中断
	{			
	}
	TIM3->SR&=~(1<<0);//清除中断标志位 	    
}



/*************************************END************************************/







